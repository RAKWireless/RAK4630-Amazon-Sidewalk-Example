## drivers/sensor/Kconfig
```kconfig
# SPDX-License-Identifier: Apache-2.0

if SENSOR
rsource "aht20/Kconfig"
rsource "rak1901/Kconfig"
endif # SENSOR
```

## drivers/sensor/aht20/Kconfig
```kconfig
# AHT20 temperature and humidity sensor configuration options

# SPDX-License-Identifier: Apache-2.0

config AHT20
	bool "AHT20 Temperature and Humidity Sensor"
	default y
	depends on DT_HAS_ASAIR_AHT20_ENABLED
	select I2C
	select CRC
	help
	  Enable driver for AHT20 temperature and humidity sensors.
```

## drivers/sensor/rak1901/Kconfig
```kconfig
# AHT20 temperature and humidity sensor configuration options

# SPDX-License-Identifier: Apache-2.0

config RAK1901
	bool "RAK1901 Temperature and Humidity Sensor"
	default y
	depends on DT_HAS_RAK1901_ENABLED
	select I2C
	select CRC
	help
	  Enable driver for RAK1901 temperature and humidity sensors.
```

## dts/bindings/sensor/asair,aht20.yaml
```yaml
# SPDX-License-Identifier: Apache-2.0

description: ASAIR AHT20 humidity and temperature sensor

compatible: "asair,aht20"

include: [sensor-device.yaml, i2c-device.yaml]
```

## dts/bindings/sensor/rak1901.yaml
```yaml
# SPDX-License-Identifier: Apache-2.0

description: RAK1901 humidity and temperature sensor

compatible: "rak1901"

include: [sensor-device.yaml, i2c-device.yaml]
```

## west.yml
```yaml
# Copyright (c) 2021 Nordic Semiconductor ASA
# SPDX-License-Identifier: Apache-2.0

manifest:
  self:
    path: rak-sid
    west-commands: scripts/west-commands.yml
    userdata:
      patches_dirs:
        - patches/west-sidewalk

  remotes:
    - name: ncs
      url-base: https://github.com/nrfconnect

  projects:
    - name: nrf
      remote: ncs
      repo-path: sdk-nrf
      revision: v2.9.1
      import: true
    - name: sidewalk
      remote: ncs
      repo-path: sdk-sidewalk
      revision: v2.9.1
```
